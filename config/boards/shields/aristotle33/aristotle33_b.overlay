/*
* Copyright (c) 2021 Bennett Helm
* SPDX-License-Identifier: MIT
*/

#include "aristotle33.dtsi"

// This is for nice!nano board (version "b") with GPIO that's broken

&kscan0 {
    row-gpios
        = <&pro_micro 15 (GPIO_ACTIVE_HIGH | GPIO_PULL_DOWN)>
        , <&pro_micro  9 (GPIO_ACTIVE_HIGH | GPIO_PULL_DOWN)>
        , <&pro_micro  7 (GPIO_ACTIVE_HIGH | GPIO_PULL_DOWN)>
        , <&pro_micro 21 (GPIO_ACTIVE_HIGH | GPIO_PULLOWN)>
        ;
};
