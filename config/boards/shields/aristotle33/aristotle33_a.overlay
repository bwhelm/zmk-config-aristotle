/*
* Copyright (c) 2021 Bennett Helm
* SPDX-License-Identifier: MIT
*/

#include "aristotle33.dtsi"

// This is for nice!nano board (version "a") with GPIO that's broken

&kscan0 {
    col-gpios
        = <&pro_micro_a  3  GPIO_ACTIVE_HIGH>
        , <&pro_micro_d  4  GPIO_ACTIVE_HIGH>
        , <&pro_micro_d  6  GPIO_ACTIVE_HIGH>
        , <&pro_micro_d  8  GPIO_ACTIVE_HIGH>
        , <&pro_micro_d 14  GPIO_ACTIVE_HIGH>
        , <&pro_micro_d 16  GPIO_ACTIVE_HIGH>
        , <&pro_micro_d 10  GPIO_ACTIVE_HIGH>
        , <&pro_micro_d  0  GPIO_ACTIVE_HIGH>
        , <&pro_micro_d  2  GPIO_ACTIVE_HIGH>
        ;
};
