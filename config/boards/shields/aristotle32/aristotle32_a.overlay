/*
* Copyright (c) 2022 Bennett Helm
* SPDX-License-Identifier: MIT
*/

#include "aristotle32.dtsi"

// This is for nice!nano board (version "a") with GPIO that's broken

&kscan0 {
    col-gpios
        = <&pro_micro 21  GPIO_ACTIVE_HIGH>
        , <&pro_micro  4  GPIO_ACTIVE_HIGH>
        , <&pro_micro  6  GPIO_ACTIVE_HIGH>
        , <&pro_micro  8  GPIO_ACTIVE_HIGH>
        , <&pro_micro 14  GPIO_ACTIVE_HIGH>
        , <&pro_micro 16  GPIO_ACTIVE_HIGH>
        , <&pro_micro 10  GPIO_ACTIVE_HIGH>
        , <&pro_micro  0  GPIO_ACTIVE_HIGH>
        , <&pro_micro  2  GPIO_ACTIVE_HIGH>
        ;
};
