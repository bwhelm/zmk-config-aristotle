## config/boards/shields/aristotle32/Kconfig.defconfig
```kconfig
# Copyright (c) 2022-24 Bennett Helm
# SPDX-License-Identifier: MIT

if SHIELD_ARISTOTLE32

config ZMK_KEYBOARD_NAME
    default "Aristotle 32'22t"

endif

if SHIELD_ARISTOTLE32_A

config ZMK_KEYBOARD_NAME
    default "Aristotle 32'22ta"

endif

if SHIELD_ARISTOTLE32_B

config ZMK_KEYBOARD_NAME
    default "Aristotle 32'22tb"

endif
```

## config/boards/shields/aristotle32/Kconfig.shield
```kconfig
# Copyright (c) 2022-24 Bennett Helm
# SPDX-License-Identifier: MIT

config SHIELD_ARISTOTLE32
    def_bool $(shields_list_contains,aristotle32)

config SHIELD_ARISTOTLE32_A
    def_bool $(shields_list_contains,aristotle32_a)

config SHIELD_ARISTOTLE32_B
    def_bool $(shields_list_contains,aristotle32_b)

config ZMK_SPLIT
    default n
```

## config/boards/shields/aristotle33/Kconfig.defconfig
```kconfig
# Copyright (c) 2021 Bennett Helm
# SPDX-License-Identifier: MIT

if SHIELD_ARISTOTLE33

config ZMK_KEYBOARD_NAME
    default "Aristotle 33'21"

endif

if SHIELD_ARISTOTLE33_A

config ZMK_KEYBOARD_NAME
    default "Aristotle 33'21a"

endif

if SHIELD_ARISTOTLE33_B

config ZMK_KEYBOARD_NAME
    default "Aristotle 33'21b"

endif
```

## config/boards/shields/aristotle33/Kconfig.shield
```kconfig
# Copyright (c) 2021 Bennett Helm
# SPDX-License-Identifier: MIT

config SHIELD_ARISTOTLE33
    def_bool $(shields_list_contains,aristotle33)

config SHIELD_ARISTOTLE33_A
    def_bool $(shields_list_contains,aristotle33_a)

config SHIELD_ARISTOTLE33_B
    def_bool $(shields_list_contains,aristotle33_b)

config ZMK_SPLIT
    default n
```
